## conf/layer.conf
```bitbake
# We have a conf and classes directory, add to BBPATH
BBPATH .= ":${LAYERDIR}"

# We have recipes-* directories, add to BBFILES
BBFILES += "${LAYERDIR}/recipes-*/*/*.bb \
	${LAYERDIR}/recipes-*/*/*.bbappend"

BBFILE_COLLECTIONS += "rauc-disk-updater"
BBFILE_PATTERN_rauc-disk-updater = "^${LAYERDIR}/"
BBFILE_PRIORITY_rauc-disk-updater = "6"

LAYERDEPENDS_rauc-disk-updater = "core rauc"

LAYERSERIES_COMPAT_rauc-disk-updater = "zeus"
```
